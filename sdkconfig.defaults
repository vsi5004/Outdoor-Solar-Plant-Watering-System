## sdkconfig.defaults
```kconfig
# Production sdkconfig defaults for plant-waterer (ESP32-C6).
# Values here are applied when no sdkconfig exists yet.
# Run `idf.py menuconfig` to override; committed sdkconfig takes precedence.

# ── Partition table ───────────────────────────────────────────────────────────
# Custom table adds zb_storage (NVS partition required by the Zigbee stack to
# persist network credentials and routing/binding tables across reboots).
CONFIG_PARTITION_TABLE_CUSTOM=y
CONFIG_PARTITION_TABLE_CUSTOM_FILENAME="partitions.csv"

# ── Zigbee ────────────────────────────────────────────────────────────────────
# Enable the Zigbee stack and configure the device as a Full Function Device
# (router role) so it can relay traffic for other Zigbee nodes on the network.
CONFIG_ZB_ENABLED=y
CONFIG_ZB_ZCZR=y

# ── CPU & timing ─────────────────────────────────────────────────────────────
# 160 MHz gives the Zigbee stack enough headroom alongside the watering logic.
CONFIG_ESP_DEFAULT_CPU_FREQ_MHZ_160=y

# 1 ms FreeRTOS tick — pdMS_TO_TICKS() calls throughout the firmware assume
# this resolution.
CONFIG_FREERTOS_HZ=1000

# ── Stack sizes ───────────────────────────────────────────────────────────────
# app_main creates tasks and then returns; 3 kB is sufficient.
CONFIG_ESP_MAIN_TASK_STACK_SIZE=3072

# ── Logging ───────────────────────────────────────────────────────────────────
CONFIG_LOG_DEFAULT_LEVEL_INFO=y
```

## test/target/sdkconfig.defaults
```kconfig
# Test-binary overrides — not for production firmware.
#
# unity_run_menu() blocks in a UART busy-wait, which prevents the IDLE task
# from running and triggers the task watchdog.  Disabling idle-task monitoring
# here is safe because we never sleep or deep-idle during target tests.
CONFIG_ESP_TASK_WDT_CHECK_IDLE_TASK_CPU0=n
```
